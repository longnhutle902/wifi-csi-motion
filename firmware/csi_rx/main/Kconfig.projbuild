## firmware/csi_rx/main/Kconfig.projbuild
```kconfig
menu "CSI RX configuration"
    config CSI_WIFI_CHANNEL
        int "Wi-Fi channel (must match TX)"
        range 1 13
        default 11
endmenu
```

## firmware/csi_rx/sdkconfig.defaults
```kconfig
CONFIG_IDF_TARGET="esp32s3"
CONFIG_ESPTOOLPY_FLASHSIZE_16MB=y
CONFIG_FREERTOS_HZ=1000
CONFIG_ESP_CONSOLE_UART_CUSTOM=y
CONFIG_ESP_CONSOLE_UART_BAUDRATE=921600
CONFIG_ESPTOOLPY_MONITOR_BAUD=921600
CONFIG_ESP_WIFI_CSI_ENABLED=y
CONFIG_ESP_WIFI_AMPDU_TX_ENABLED=n
CONFIG_ESP_WIFI_AMPDU_RX_ENABLED=n
CONFIG_ESP_WIFI_STATIC_RX_BUFFER_NUM=16
CONFIG_ESP_WIFI_DYNAMIC_RX_BUFFER_NUM=64
CONFIG_LOG_DEFAULT_LEVEL_INFO=y
```

## firmware/csi_tx/main/Kconfig.projbuild
```kconfig
menu "CSI TX configuration"
    config CSI_WIFI_CHANNEL
        int "Wi-Fi channel (must match RX)"
        range 1 13
        default 11
    config CSI_SEND_RATE_HZ
        int "Packets per second"
        range 10 1000
        default 50
    config CSI_TX_POWER_QDBM
        int "Max TX power in 0.25 dBm units (8..84)"
        range 8 84
        default 60
endmenu
```
